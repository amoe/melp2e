/dts-v1/;
{
    intc: interrupt-controller@48200000 {
          compatible = "ti,am33xx-intc";
          interrupt-controller;
          #interrupt-cells = <1>;
          reg = <0x48200000 0x1000>;
    };
    lcdc: lcdc@4830e000 {
          compatible = "ti,am33xx-tilcdc";
          reg = <0x4830e000 0x1000>;
          interrupt-parent = <&intc>;
          interrupts = <36>;
          ti,hwmods = "lcdc";
          status = "disabled";
    };
};
